#include "gsm_handler.h"
#include <HardwareSerial.h>
#include <ArduinoJson.h>
#include "config.h"

HardwareSerial GSMSerial(1); // Use UART1

GSMHandler::GSMHandler() {}

bool GSMHandler::init() {
    GSMSerial.begin(GSM_BAUDRATE, SERIAL_8N1, GSM_RX_PIN, GSM_TX_PIN);
    Serial.println("GSM UART Initialized.");
    
    // Check communication
    if (sendATCommand("AT", 2000).indexOf("OK") == -1) {
        Serial.println("GSM Module not responding to AT");
        return false;
    }
    
    // Disable echo
    sendATCommand("ATE0", 1000);
    
    // Check SIM
    if (sendATCommand("AT+CPIN?", 2000).indexOf("READY") == -1) {
        Serial.println("SIM Card not ready!");
        return false;
    }
    
    return enableNetwork();
}

bool GSMHandler::enableNetwork() {
    // Attach to network
    sendATCommand("AT+CGATT=1", 5000);
    
    // Setup APN
    String cgactCmd = "AT+CGACT=1,1";
    sendATCommand(cgactCmd, 2000);
    
    return true;
}

bool GSMHandler::initHTTP() {
    sendATCommand("AT+HTTPINIT", 2000, false); // Ignore if already init
    return true;
}

bool GSMHandler::sendAlertTrigger(float lat, float lng) {
    if (!initHTTP()) return false;
    
    String url = String(BACKEND_BASE_URL) + API_TRIGGER_ENDPOINT;
    sendATCommand("AT+HTTPPARA=\"URL\",\"" + url + "\"", 1000);
    sendATCommand("AT+HTTPPARA=\"CONTENT\",\"application/json\"", 1000);
    
    // Optional: Add JWT Token header if using Bearer Auth
    String authHeader = "Authorization: Bearer " + String(APP_AUTH_TOKEN);
    sendATCommand("AT+HTTPPARA=\"USERDATA\",\"" + authHeader + "\\r\\n\"", 1000);
    
    // Create JSON payload
    StaticJsonDocument<200> doc;
    doc["user_id"] = APP_USER_ID;
    doc["device_id"] = APP_DEVICE_ID;
    doc["latitude"] = lat;
    doc["longitude"] = lng;
    
    String payload;
    serializeJson(doc, payload);
    
    sendATCommand("AT+HTTPDATA=" + String(payload.length()) + ",10000", 2000);
    GSMSerial.print(payload);
    delay(500); // Wait for data to be ingested by module
    
    String response = sendATCommand("AT+HTTPACTION=1", 10000); // 1 = POST
    if (response.indexOf("+HTTPACTION: 1,200") != -1) {
        Serial.println("Alert triggered successfully!");
        return true;
    }
    
    Serial.println("Failed to trigger alert. Response: " + response);
    return false;
}

bool GSMHandler::sendLocationUpdate(const String& alertId, float lat, float lng) {
    if (!initHTTP()) return false;
    
    String url = String(BACKEND_BASE_URL) + API_LOCATION_ENDPOINT;
    sendATCommand("AT+HTTPPARA=\"URL\",\"" + url + "\"", 1000);
    sendATCommand("AT+HTTPPARA=\"CONTENT\",\"application/json\"", 1000);
    
    String authHeader = "Authorization: Bearer " + String(APP_AUTH_TOKEN);
    sendATCommand("AT+HTTPPARA=\"USERDATA\",\"" + authHeader + "\\r\\n\"", 1000);
    
    // Create JSON payload
    StaticJsonDocument<200> doc;
    doc["alert_id"] = alertId;
    doc["latitude"] = lat;
    doc["longitude"] = lng;
    // timestamp will be generated by the backend or ISO string can be added here
    
    String payload;
    serializeJson(doc, payload);
    
    sendATCommand("AT+HTTPDATA=" + String(payload.length()) + ",10000", 2000);
    GSMSerial.print(payload);
    delay(500);
    
    String response = sendATCommand("AT+HTTPACTION=1", 10000);
    if (response.indexOf("+HTTPACTION: 1,200") != -1) {
        Serial.println("Location updated successfully!");
        return true;
    }
    
    return false;
}

String GSMHandler::sendATCommand(const String& cmd, const unsigned long timeout, bool expectOk) {
    String response = "";
    GSMSerial.println(cmd);
    
    unsigned long startTime = millis();
    while (millis() - startTime < timeout) {
        while (GSMSerial.available() > 0) {
            char c = GSMSerial.read();
            response += c;
        }
        if (expectOk && response.indexOf("OK") != -1) {
            break;
        }
        if (response.indexOf("ERROR") != -1) {
            break;
        }
    }
    
    Serial.print("Cmd: ");
    Serial.print(cmd);
    Serial.print(" | Resp: ");
    Serial.println(response);
    
    return response;
}
